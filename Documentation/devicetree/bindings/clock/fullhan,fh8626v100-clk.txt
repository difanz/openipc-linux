## Documentation/devicetree/bindings/clock/fullhan,fh8626v100-clk.txt
```
Fullhan FH8626V100 clock controller

Required properties:
- compatible: "fullhan,fh8626v100-clk"
- reg: the PMU window. This node shares that window with the
  "fullhan,fh8626v100-pmu" system controller.
- #clock-cells: must be <1>
- clocks: the oscillator input
- clock-names: "osc"

Clock index values are defined in
include/dt-bindings/clock/fh8626v100-clk.h.

Example:

	clock-controller@f0000000 {
		compatible = "fullhan,fh8626v100-clk";
		reg = <0xf0000000 0x4000>;
		#clock-cells = <1>;
		clocks = <&osc>;
		clock-names = "osc";
	};
```

## Documentation/devicetree/bindings/gpio/fullhan,fh8626v100-gpio.txt
```
Fullhan FH8626V100 GPIO controller

The parent node owns the controller window. Each port is a child
node. The child uses the Synopsys DW APB GPIO port binding; see
Documentation/devicetree/bindings/gpio/snps-dwapb-gpio.txt.
Port properties are not redefined here.

Required parent properties:
- compatible: "fullhan,fh8626v100-gpio"
- reg: MMIO window of the controller
- #address-cells: must be <1>
- #size-cells: must be <0>

Example:

	gpio-controller@f0300000 {
		compatible = "fullhan,fh8626v100-gpio";
		reg = <0xf0300000 0x4000>;
		#address-cells = <1>;
		#size-cells = <0>;

		gpio-controller@0 {
			compatible = "snps,dw-apb-gpio-port";
			reg = <0>;
		};
	};
```

## Documentation/devicetree/bindings/usb/fullhan,fh8626v100-usb.txt
```
Fullhan FH8626V100 USB host
==========================

Synopsys DWC2 with integrated UTMI PHY and Fullhan PMU sequence.
Required properties:
- compatible: "fullhan,fh8626v100-usb" (no generic fallback)
- reg: controller window, 0xe0700000 / 0x4000 on V100
- interrupts: hardware source 27
- clocks: USB functional clock and USB HCLK gate
- clock-names: "otg", "hclk"
- dr_mode: "host"
- vbus-supply: explicit regulator controlling the board's downstream USB power

The Fullhan PMU/clock provider supplies serialized register access. No
second PMU mapping, external PHY or reset phandle is needed for this IP.
Only integrated UTMI 16-bit host is supported. The board describes its power
switch as a regulator; the driver does not assume a GPIO number or voltage.
```
